## boards/shields/nice_view_corne/Kconfig.defconfig
```kconfig
# Copyright (c) 2024 The ZMK Contributors
# SPDX-License-Identifier: MIT

if SHIELD_NICE_VIEW_CORNE

config LV_Z_VDB_SIZE
    default 100

config LV_DPI_DEF
    default 161

config LV_Z_BITS_PER_PIXEL
    default 1

choice LV_COLOR_DEPTH
    default LV_COLOR_DEPTH_1
endchoice

choice ZMK_DISPLAY_WORK_QUEUE
    default ZMK_DISPLAY_WORK_QUEUE_DEDICATED
endchoice

choice ZMK_DISPLAY_STATUS_SCREEN
    default ZMK_DISPLAY_STATUS_SCREEN_CUSTOM
endchoice

config LV_Z_MEM_POOL_SIZE
    default 8192 if ZMK_DISPLAY_STATUS_SCREEN_CUSTOM

config ZMK_DISPLAY_STATUS_SCREEN_CUSTOM
    imply NICE_VIEW_CORNE_WIDGET

config NICE_VIEW_CORNE_WIDGET
    bool "Custom nice!view Corne display widget"
    select LV_FONT_MONTSERRAT_16
    select LV_USE_IMG
    select LV_USE_CANVAS

if !ZMK_SPLIT || ZMK_SPLIT_ROLE_CENTRAL

config NICE_VIEW_CORNE_WIDGET
    select LV_FONT_MONTSERRAT_18
    select LV_FONT_MONTSERRAT_14

endif # !ZMK_SPLIT || ZMK_SPLIT_ROLE_CENTRAL

if ZMK_SPLIT && !ZMK_SPLIT_ROLE_CENTRAL

config NICE_VIEW_CORNE_WIDGET
    select LV_FONT_UNSCII_8

endif # peripheral

config ZMK_DISPLAY_STATUS_SCREEN_BUILT_IN
    select LV_FONT_MONTSERRAT_26

endif # SHIELD_NICE_VIEW_CORNE
```

## boards/shields/nice_view_corne/Kconfig.shield
```kconfig
# Copyright (c) 2024 The ZMK Contributors
# SPDX-License-Identifier: MIT

config SHIELD_NICE_VIEW_CORNE
    def_bool $(shields_list_contains,nice_view_corne)
```
